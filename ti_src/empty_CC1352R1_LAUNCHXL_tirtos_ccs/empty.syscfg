// These arguments were used when this file was generated. They will be automatically applied on subsequent loads 
// via the GUI or CLI invocations. Run CLI with '--help' for additional information on how to override these arguments.
// @cliArgs --board "/ti/boards/CC1352R1_LAUNCHXL" --product "simplelink_cc13x2_26x2_sdk@3.30.00.03"
// @versions {"data":"2019083011","timestamp":"2019083011","tool":"1.2.952","templates":"2019083011"}

var RTOS = scripting.addModule("/ti/drivers/RTOS");
var GPIO = scripting.addModule("/ti/drivers/GPIO");
var Power = scripting.addModule("/ti/drivers/Power");
var CCFG = scripting.addModule("/ti/devices/CCFG");
var Board = scripting.addModule("/ti/drivers/Board");
var DriverLib = scripting.addModule("/ti/devices/DriverLib");
var LED = scripting.addModule("/ti/drivers/apps/LED");
var LED1 = LED.addInstance();
var LED2 = LED.addInstance();
var Button = scripting.addModule("/ti/drivers/apps/Button");
var Button1 = Button.addInstance();
var Button2 = Button.addInstance();
var DMA = scripting.addModule("/ti/drivers/DMA");
var I2C = scripting.addModule("/ti/drivers/I2C");
var I2C1 = I2C.addInstance();
// Name
CCFG.ccfgTemplate.$name = "ti_devices_CCFGTemplate0";
// Name - The C/C++ identifier used in applications as the index parameter passed to LED runtime APIs
LED1.$name = "CONFIG_LED_0";
// Use Hardware - Select the hardware to use, or 'None' to use available header pins
LED1.$hardware = system.deviceData.board.components.LED_RED;
// Mode - Select the GPIO mode
LED1.gpioPin.mode = "Output";
// Callback Function - The name of the callback function called when this GPIO pin triggers an interrupt, or 'NULL' if it's specified at runtime
LED1.gpioPin.callbackFunction = "";
// Name
LED1.gpioPin.pinInstance.$name = "CONFIG_PIN_1";
// Name - The C/C++ identifier used in applications as the index parameter passed to LED runtime APIs
LED2.$name = "CONFIG_LED_1";
// Use Hardware - Select the hardware to use, or 'None' to use available header pins
LED2.$hardware = system.deviceData.board.components.LED_GREEN;
// Mode - Select the GPIO mode
LED2.gpioPin.mode = "Output";
// Callback Function - The name of the callback function called when this GPIO pin triggers an interrupt, or 'NULL' if it's specified at runtime
LED2.gpioPin.callbackFunction = "";
// Assign pin
LED2.gpioPin.gpioPin.$assign = "boosterpack.40"; // DIO7
// Name
LED2.gpioPin.pinInstance.$name = "CONFIG_PIN_2";
// Name - The C/C++ identifier used in applications as the index parameter passed to Button runtime APIs
Button1.$name = "CONFIG_BUTTON_0";
// Use Hardware - Select the hardware to use, or 'None' to use available header pins
Button1.$hardware = system.deviceData.board.components["BTN-1"];
// Name - The C/C++ identifier used in applications as the index parameter passed to GPIO runtime APIs
Button1.gpioPin.$name = "CONFIG_GPIO_0";
// Pull - Specifies the internal pull-up or pull-down resistor configuration of this GPIO pin.
Button1.gpioPin.pull = "Pull Up";
// Interrupt Trigger - Specifies when or if interrupts are triggered
Button1.gpioPin.interruptTrigger = "Rising Edge";
// Name
Button1.gpioPin.pinInstance.$name = "CONFIG_PIN_0";
// Name - The C/C++ identifier used in applications as the index parameter passed to Button runtime APIs
Button2.$name = "CONFIG_BUTTON_1";
// Use Hardware - Select the hardware to use, or 'None' to use available header pins
Button2.$hardware = system.deviceData.board.components["BTN-2"];
// Name - The C/C++ identifier used in applications as the index parameter passed to GPIO runtime APIs
Button2.gpioPin.$name = "CONFIG_GPIO_1";
// Pull - Specifies the internal pull-up or pull-down resistor configuration of this GPIO pin.
Button2.gpioPin.pull = "Pull Up";
// Interrupt Trigger - Specifies when or if interrupts are triggered
Button2.gpioPin.interruptTrigger = "Rising Edge";
// Name
Button2.gpioPin.pinInstance.$name = "CONFIG_PIN_3";
// Name - The C/C++ identifier used in applications as the index parameter passed to I2C runtime APIs
I2C1.$name = "CONFIG_I2C_0";
// Name
I2C1.i2c.$name = "MyI2C1";
// Name
I2C1.sdaPinInstance.$name = "CONFIG_PIN_7";
// Name
I2C1.clkPinInstance.$name = "CONFIG_PIN_8";
// Suggest solution
LED1.gpioPin.gpioPin.$suggestSolution = "11";
// Suggest solution
Button1.gpioPin.gpioPin.$suggestSolution = "21";
// Suggest solution
Button2.gpioPin.gpioPin.$suggestSolution = "20";
// Suggest solution
I2C1.i2c.$suggestSolution = "I2C0";
// Suggest solution
I2C1.i2c.sdaPin.$suggestSolution = "10";
// Suggest solution
I2C1.i2c.sclPin.$suggestSolution = "9";
