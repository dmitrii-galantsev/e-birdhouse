// These arguments were used when this file was generated. They will be automatically applied on subsequent loads 
// via the GUI or CLI invocations. Run CLI with '--help' for additional information on how to override these arguments.
// @cliArgs --board "/ti/boards/CC1352R1_LAUNCHXL" --product "simplelink_cc13x2_26x2_sdk@3.30.00.03"
// @versions {"data":"2019083011","timestamp":"2019083011","tool":"1.2.952","templates":"2019083011"}

var RF = scripting.addModule("/ti/drivers/RF");
var CCFG = scripting.addModule("/ti/devices/CCFG");
var GPIO = scripting.addModule("/ti/drivers/GPIO");
var GPIO1 = GPIO.addInstance();
var GPIO2 = GPIO.addInstance();
var easylink = scripting.addModule("/ti/easylink/easylink");
var UART = scripting.addModule("/ti/drivers/UART");
var UART1 = UART.addInstance();
var Power = scripting.addModule("/ti/drivers/Power");
var Board = scripting.addModule("/ti/drivers/Board");
var DriverLib = scripting.addModule("/ti/devices/DriverLib");
// Enable Bootloader - Enable ROM Bootloader, for flashing from external host
CCFG.enableBootloader = true;
// Enable Bootloader Backdoor - When enabling the Bootloader Backdoor, the Bootloader can be activated externally by pulling a pin, even when a valid flash image is present. Note, enabling the backdoor allows an external host to read back a flash image from the device
CCFG.enableBootloaderBackdoor = true;
// Bootloader Backdoor DIO - DIO (pin) to trigger Bootloader backdoor, this pin is only needed at boot
CCFG.dioBootloaderBackdoor = 15;
// Trigger Level of Bootloader Backdoor - Active high or low on selected DIO to open boot loader backdoor
CCFG.levelBootloaderBackdoor = "Active low";
// Force VDDR - Necessary for external load mode, or for maximum PA output power
CCFG.forceVddr = true;
// Name
CCFG.ccfgTemplate.$name = "ti_devices_CCFGTemplate0";
// Use Hardware - Select the hardware to use, or 'None' to use available header pins
GPIO1.$hardware = system.deviceData.board.components.LED_RED;
// Name - The C/C++ identifier used in applications as the index parameter passed to GPIO runtime APIs
GPIO1.$name = "CONFIG_GPIO_RLED";
// Name
GPIO1.pinInstance.$name = "CONFIG_PIN_RLED";
// Use Hardware - Select the hardware to use, or 'None' to use available header pins
GPIO2.$hardware = system.deviceData.board.components.LED_GREEN;
// Name - The C/C++ identifier used in applications as the index parameter passed to GPIO runtime APIs
GPIO2.$name = "CONFIG_GPIO_GLED";
// Name
GPIO2.pinInstance.$name = "CONFIG_PIN_GLED";
// Name
easylink.radioConfigEasylinkPhyCustom.codeExportConfig.$name = "ti_radioconfig_code_export_param0";
var multi_stack_validate = scripting.addModule("/ti/easylink/multi_stack_validate");
// Use Hardware - Select the hardware to use, or 'None' to use available header pins
UART1.$hardware = system.deviceData.board.components.XDS110UART;
// Name - The C/C++ identifier used in applications as the index parameter passed to UART runtime APIs
UART1.$name = "CONFIG_UART";
// Name
UART1.txPinInstance.$name = "CONFIG_PIN_0";
// Name
UART1.rxPinInstance.$name = "CONFIG_PIN_1";
// Name
UART1.uart.$name = "MyUART1";
// Suggest solution
GPIO1.gpioPin.$suggestSolution = "11";
// Suggest solution
GPIO2.gpioPin.$suggestSolution = "12";
// Suggest solution
UART1.uart.$suggestSolution = "UART0";
// Suggest solution
UART1.uart.txPin.$suggestSolution = "19";
// Suggest solution
UART1.uart.rxPin.$suggestSolution = "18";
