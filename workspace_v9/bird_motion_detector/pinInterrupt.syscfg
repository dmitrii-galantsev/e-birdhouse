// These arguments were used when this file was generated. They will be automatically applied on subsequent loads 
// via the GUI or CLI invocations. Run CLI with '--help' for additional information on how to override these arguments.
// @cliArgs --board "/ti/boards/CC1352R1_LAUNCHXL" --product "simplelink_cc13x2_26x2_sdk@3.30.00.03"
// @versions {"data":"2019083011","timestamp":"2019083011","tool":"1.2.952","templates":"2019083011"}

var RTOS = scripting.addModule("/ti/drivers/RTOS");
var PIN = scripting.addModule("/ti/drivers/PIN");
var PIN1 = PIN.addInstance();
var PIN2 = PIN.addInstance();
var PIN3 = PIN.addInstance();
var PIN4 = PIN.addInstance();
var GPIO = scripting.addModule("/ti/drivers/GPIO");
var GPIO1 = GPIO.addInstance();
// name - Select the RTOS being used
RTOS.name = "NoRTOS";
var Power = scripting.addModule("/ti/drivers/Power");
var CCFG = scripting.addModule("/ti/devices/CCFG");
// Name
CCFG.ccfgTemplate.$name = "ti_devices_CCFGTemplate0";
var Board = scripting.addModule("/ti/drivers/Board");
var DriverLib = scripting.addModule("/ti/devices/DriverLib");
// Use Hardware - Select the hardware to use, or 'None' to use available header pins
PIN1.$hardware = system.deviceData.board.components["BTN-1"];
// Name
PIN1.$name = "CONFIG_PIN_BUTTON_0";
// Use Hardware - Select the hardware to use, or 'None' to use available header pins
PIN2.$hardware = system.deviceData.board.components["BTN-2"];
// Name
PIN2.$name = "CONFIG_PIN_BUTTON_1";
// Use Hardware - Select the hardware to use, or 'None' to use available header pins
PIN3.$hardware = system.deviceData.board.components.LED_RED;
// Name
PIN3.$name = "CONFIG_PIN_LED_0";
// Use Hardware - Select the hardware to use, or 'None' to use available header pins
PIN4.$hardware = system.deviceData.board.components.LED_GREEN;
// Name
PIN4.$name = "CONFIG_PIN_LED_1";
// Name - The C/C++ identifier used in applications as the index parameter passed to GPIO runtime APIs
GPIO1.$name = "CONFIG_GPIO_0";
// Pull - Specifies the internal pull-up or pull-down resistor configuration of this GPIO pin.
GPIO1.pull = "Pull Down";
// Assign pin
GPIO1.gpioPin.$assign = "boosterpack.10"; // DIO5
// Name
GPIO1.pinInstance.$name = "CONFIG_PIN_0";
// Suggest solution
PIN1.pinPin.$suggestSolution = "21";
// Suggest solution
PIN2.pinPin.$suggestSolution = "20";
// Suggest solution
PIN3.pinPin.$suggestSolution = "11";
// Suggest solution
PIN4.pinPin.$suggestSolution = "12";
