// These arguments were used when this file was generated. They will be automatically applied on subsequent loads 
// via the GUI or CLI invocations. Run CLI with '--help' for additional information on how to override these arguments.
// @cliArgs --board "/ti/boards/CC1352R1_LAUNCHXL" --product "simplelink_cc13x2_26x2_sdk@3.30.00.03"
// @versions {"data":"2019083011","timestamp":"2019083011","tool":"1.2.952","templates":"2019083011"}

// Add a BAS Sensors BoosterPack boosterpack
var BOOSTXL_BASSENSORS = scripting.addHardware("/ti/boards/boosterpacks/BOOSTXL-BASSENSORS");
var RTOS = scripting.addModule("/ti/drivers/RTOS");
var Display = scripting.addModule("/ti/display/Display");
var Display1 = Display.addInstance();
var GPIO = scripting.addModule("/ti/drivers/GPIO");
var GPIO1 = GPIO.addInstance();
var GPIO2 = GPIO.addInstance();
var I2C = scripting.addModule("/ti/drivers/I2C");
var I2C1 = I2C.addInstance();
// Name - The C/C++ identifier used in applications as the index parameter passed to Display runtime APIs
Display1.$name = "CONFIG_Display_0";
// Use Hardware - Select the hardware to use, or 'None' to use available header pins
Display1.$hardware = system.deviceData.board.components.XDS110UART;
var Board = scripting.addModule("/ti/drivers/Board");
var DriverLib = scripting.addModule("/ti/devices/DriverLib");
// Name - The C/C++ identifier used in applications as the index parameter passed to UART runtime APIs
Display1.uart.$name = "CONFIG_UART_0";
// Name
Display1.uart.txPinInstance.$name = "CONFIG_PIN_0";
// Name
Display1.uart.rxPinInstance.$name = "CONFIG_PIN_1";
var Power = scripting.addModule("/ti/drivers/Power");
var CCFG = scripting.addModule("/ti/devices/CCFG");
// Name
CCFG.ccfgTemplate.$name = "ti_devices_CCFGTemplate0";
// Name
Display1.uart.uart.$name = "MyUART1";
// Use Hardware - Select the hardware to use, or 'None' to use available header pins
GPIO1.$hardware = system.deviceData.board.components.LED_RED;
// Name - The C/C++ identifier used in applications as the index parameter passed to GPIO runtime APIs
GPIO1.$name = "CONFIG_GPIO_LED_0";
// Name
GPIO1.pinInstance.$name = "CONFIG_PIN_2";
// Name - The C/C++ identifier used in applications as the index parameter passed to GPIO runtime APIs
GPIO2.$name = "CONFIG_GPIO_TMP116_EN";
// Initial Output State - Specifies the initial output state
GPIO2.initialOutputState = "High";
// Use Hardware - Select the hardware to use, or 'None' to use available header pins
GPIO2.$hardware = system.deviceData.board.components.LED_GREEN;
// Name
GPIO2.pinInstance.$name = "CONFIG_PIN_3";
// Name - The C/C++ identifier used in applications as the index parameter passed to I2C runtime APIs
I2C1.$name = "CONFIG_I2C_TMP";
// Name
I2C1.sdaPinInstance.$name = "CONFIG_PIN_4";
// Name
I2C1.clkPinInstance.$name = "CONFIG_PIN_5";
// Name
I2C1.i2c.$name = "MyI2C1";
// Suggest solution
Display1.uart.uart.$suggestSolution = "UART1";
// Suggest solution
Display1.uart.uart.txPin.$suggestSolution = "19";
// Suggest solution
Display1.uart.uart.rxPin.$suggestSolution = "18";
// Suggest solution
GPIO1.gpioPin.$suggestSolution = "11";
// Suggest solution
GPIO2.gpioPin.$suggestSolution = "12";
// Suggest solution
I2C1.i2c.$suggestSolution = "I2C0";
// Suggest solution
I2C1.i2c.sdaPin.$suggestSolution = "26";
// Suggest solution
I2C1.i2c.sclPin.$suggestSolution = "17";
